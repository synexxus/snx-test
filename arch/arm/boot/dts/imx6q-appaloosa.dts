/*
 * Copyright 2011 Freescale Semiconductor, Inc.
 * Copyright 2011 Linaro Ltd.
 * Synexxus Appaloosa
 *
 * This file is dual-licensed: you can use it either under the terms
 * of the GPL or the X11 license, at your option. Note that this dual
 * licensing only applies to this file, and not this project as a
 * whole.
 *
 *  a) This file is free software; you can redistribute it and/or
 *     modify it under the terms of the GNU General Public License
 *     version 2 as published by the Free Software Foundation.
 *
 *     This file is distributed in the hope that it will be useful,
 *     but WITHOUT ANY WARRANTY; without even the implied warranty of
 *     MERCHANTABILITY or FITNESS FOR A PARTICULAR PURPOSE.  See the
 *     GNU General Public License for more details.
 *
 * Or, alternatively,
 *
 *  b) Permission is hereby granted, free of charge, to any person
 *     obtaining a copy of this software and associated documentation
 *     files (the "Software"), to deal in the Software without
 *     restriction, including without limitation the rights to use,
 *     copy, modify, merge, publish, distribute, sublicense, and/or
 *     sell copies of the Software, and to permit persons to whom the
 *     Software is furnished to do so, subject to the following
 *     conditions:
 *
 *     The above copyright notice and this permission notice shall be
 *     included in all copies or substantial portions of the Software.
 *
 *     THE SOFTWARE IS PROVIDED "AS IS", WITHOUT WARRANTY OF ANY KIND,
 *     EXPRESS OR IMPLIED, INCLUDING BUT NOT LIMITED TO THE WARRANTIES
 *     OF MERCHANTABILITY, FITNESS FOR A PARTICULAR PURPOSE AND
 *     NONINFRINGEMENT. IN NO EVENT SHALL THE AUTHORS OR COPYRIGHT
 *     HOLDERS BE LIABLE FOR ANY CLAIM, DAMAGES OR OTHER LIABILITY,
 *     WHETHER IN AN ACTION OF CONTRACT, TORT OR OTHERWISE, ARISING
 *     FROM, OUT OF OR IN CONNECTION WITH THE SOFTWARE OR THE USE OR
 *     OTHER DEALINGS IN THE SOFTWARE.
 */

/dts-v1/;
#include "imx6q.dtsi"
#include "imx6qdl-appaloosa.dtsi"

/ {
	model = "Synexxus Appaloosa";
	compatible = "fsl,imx6q-appaloosa", "fsl,imx6q";
};

&sata {
	status = "okay";
};

/* From imx6q-gw54xx.dts */
&ipu2_csi1 {
	pinctrl-names = "default";
	pinctrl-0 = <&pinctrl_ipu2_csi1>;
};

&iomuxc {
/*
	pinctrl_ipu2_csi1: ipu2_csi1grp {
		fsl,pins = <
			MX6QDL_PAD_EIM_DA5__IPU2_CSI1_DATA04    0x1b0b0
			MX6QDL_PAD_EIM_DA4__IPU2_CSI1_DATA05    0x1b0b0
			MX6QDL_PAD_EIM_DA3__IPU2_CSI1_DATA06    0x1b0b0
			MX6QDL_PAD_EIM_DA2__IPU2_CSI1_DATA07    0x1b0b0
			MX6QDL_PAD_EIM_DA1__IPU2_CSI1_DATA08    0x1b0b0
			MX6QDL_PAD_EIM_DA0__IPU2_CSI1_DATA09    0x1b0b0
			MX6QDL_PAD_EIM_EB1__IPU2_CSI1_DATA10    0x1b0b0
			MX6QDL_PAD_EIM_EB0__IPU2_CSI1_DATA11    0x1b0b0
			MX6QDL_PAD_EIM_DA12__IPU2_CSI1_VSYNC     0x1b0b0
			MX6QDL_PAD_EIM_DA11__IPU2_CSI1_HSYNC     0x1b0b0
			MX6QDL_PAD_EIM_A16__IPU2_CSI1_PIXCLK    0x1b0b0
		>;
	};
*/


};

/*
&ipu1_csi1_from_mipi_vc1 {
	clock-lanes = <0>;
	data-lanes = <1 2>;
};
*/
